;
; OnOff.asm
;
; Created: 08.09.2021 14:28:45
; Author : Владимир
;

/*
; Replace with your application code
start:
При старте контроллера, обычно, первым делом инициализируют стек, 
записывая в SP адрес его дна, откуда он будет рости. 
Обычно это конец ОЗУ, а растет он к началу.
RAMEND это макроопределение указывающий на конец ОЗУ в текущем МК.
У стека есть указатель, он показывает на вершину стека. 
За указатель стека отвечает специальный регистр SP, 
а точнее это регистровая пара SPL и SPH.
Только регистры с r16 по r31 могут быть использованы с непосредственными аргументами
	ldi r16, Low(RAMEND) //Инициализация стека
	out SPL, r16
	ldi r16, High(RAMEND)
	out SPH, r16

	sbi DDRB, 3 //установить бит в регистр I/O
loop:
	sbi PORTB, 3 //установить бит на порт Б
	call Delay
	cbi PORTB, 3//очистить бит 
	call Delay
	rjmp loop //относительный переход

Delay: 
	ldi r16, 0xFF
	ldi r17, 0xFF
	ldi r18, 0x05

Delay_loop:
	subi r16, 1 //Вычитание константы
	sbci r17, 0 //Вычитание константы с переносом
	sbci r18, 0 
	brne Delay_loop //Перейти если не равно
	ret//Возврат из подпрограммы


*/
	.org	0x00
	rjmp	start

	.org	0x0C  //ставим начало на адрес таймера
	jmp		on //прыгаем на метку on

	.org	0x100

start:
//Инициализация стека будет состоять из инициализации указателя стека SP.
	ldi		r16, Low(RAMEND) //LOW - макрос для указания младшего байта константы
	out		SPL, r16 //инициализация младшего байта SP
	ldi		r16, High(RAMEND) //HIGH - макрос для указания старшего байта константы.
	out		SPH, r16 //инициализация старшего байта SP

	sbi		DDRB, 3 // устанавливает два канала (пины PD0, PD1) порта DDRD (PortD) на вывод

	sbi		PORTB, 3
	ldi		r16, (1<<WGM00)|(1<<COM01)|(1<<WGM01)|(1<<CS00) //выставляем биты на шим
	out		TCCR0, r16 // Скорость и режимы счёта

	ldi		r16, 128
	out		OCR0, r16

	ldi		r16, 0
	out		TCCR1A, r16

	ldi		r16, (1<<WGM12)|(1<<CS10)
	out		TCCR1B, r16
	//разобраться
	ldi		r16, 128
	out		OCR1AH, r16
	ldi		r16, 0
	out		OCR1AL, r16

	ldi		r16, (1<<OCIE1A) //Разрешение прерывания по совпадению
	out		TIMSK, r16 //Регистр масок прерывания

interrupt:
	sei //Установить флаг глобального разрешения прерываний
	rjmp	interrupt

on:
	cpi		r16, 0 //Сравнить
	brne	off //Перейти если не равно
	out		OCR0, r17
	inc		r17 //Добавляет 1 к содержимому регистра 
	brne	return
	ldi		r16, 1
	rjmp	return //Относительный переход

off:
	out		OCR0, r17
	dec		r17 //Уменьшение на 1
	brne	return
	ldi		r16, 0
	
return:
	reti //Возврат из прерывания
